## config/app/Kconfig.hello
```kconfig
# Copyright (c) 2022-2023 XiNGRZ
# SPDX-License-Identifier: MIT

config HW75_EXTENDED_RGB
	bool "HelloWord-style per-key RGB effects (replaces stock ZMK RGB)"
	default n
	depends on DT_HAS_CHOSEN(zmk_underglow)
	select LED_STRIP
	select WS2812_STRIP
	select SPI
	help
	  Disables CONFIG_ZMK_RGB_UNDERGLOW and links extended effects + rgb_ug behavior from this module.

if HW75_EXTENDED_RGB

# Mirror ZMK underglow Kconfig symbols (they are inside ZMK's if ZMK_RGB_UNDERGLOW and are absent when it is off).

config ZMK_RGB_UNDERGLOW_BRT_MIN
	int "RGB minimum brightness in percent"
	range 0 100
	default 0

config ZMK_RGB_UNDERGLOW_BRT_MAX
	int "RGB maximum brightness in percent"
	range ZMK_RGB_UNDERGLOW_BRT_MIN 100
	default 100

config ZMK_RGB_UNDERGLOW_HUE_STEP
	int "RGB hue step in degrees"
	range 0 359
	default 10

config ZMK_RGB_UNDERGLOW_SAT_STEP
	int "RGB saturation step in percent"
	range 0 100
	default 10

config ZMK_RGB_UNDERGLOW_BRT_STEP
	int "RGB brightness step in percent"
	range 0 100
	default 10

config ZMK_RGB_UNDERGLOW_HUE_START
	int "RGB start hue in degrees"
	range 0 359
	default 0

config ZMK_RGB_UNDERGLOW_SAT_START
	int "RGB start saturation in percent"
	range 0 100
	default 100

config ZMK_RGB_UNDERGLOW_BRT_START
	int "RGB start brightness in percent"
	range ZMK_RGB_UNDERGLOW_BRT_MIN ZMK_RGB_UNDERGLOW_BRT_MAX
	default ZMK_RGB_UNDERGLOW_BRT_MAX

config ZMK_RGB_UNDERGLOW_SPD_START
	int "RGB start animation speed"
	range 1 5
	default 3

config ZMK_RGB_UNDERGLOW_EFF_START
	int "RGB start effect (0-8, see usb_comm.proto RgbState.Effect)"
	range 0 8
	default 0

config ZMK_RGB_UNDERGLOW_ON_START
	bool "RGB starts on by default"
	default y

config ZMK_RGB_UNDERGLOW_AUTO_OFF_IDLE
	bool "Turn off RGB when keyboard is idle"
	default n

config ZMK_RGB_UNDERGLOW_AUTO_OFF_USB
	bool "Turn off RGB when USB disconnected"
	depends on USB_DEVICE_STACK
	default n

endif # HW75_EXTENDED_RGB

config HW75_TOUCHBAR
	bool "HelloWord TouchBar gestures (pan / app switch / virtual desktop)"
	default n
	depends on HW75_HID_MOUSE
	help
	  Uses key positions 82-87 as touch strip; set those keymap slots to &none on the base layer.
	  Hold FN and tap Right Ctrl to cycle mode.
```

## config/app/Kconfig.rgb_underglow
```kconfig
# Copyright (c) 2022-2023 XiNGRZ
# SPDX-License-Identifier: MIT

if HW75_RGB_UNDERGLOW

config HW75_RGB_UNDERGLOW_HUE_START
	int "HelloWord RGB initial hue"
	default 0
	range 0 359

config HW75_RGB_UNDERGLOW_SAT_START
	int "HelloWord RGB initial saturation"
	default 100
	range 0 100

config HW75_RGB_UNDERGLOW_BRT_START
	int "HelloWord RGB initial brightness"
	default 40
	range 0 100

config HW75_RGB_UNDERGLOW_SPD_START
	int "HelloWord RGB initial speed"
	default 2
	range 1 5

config HW75_RGB_UNDERGLOW_EFF_START
	int "HelloWord RGB initial effect"
	default 0
	range 0 8

config HW75_RGB_UNDERGLOW_HUE_STEP
	int "HelloWord RGB hue step"
	default 10
	range 1 359

config HW75_RGB_UNDERGLOW_SAT_STEP
	int "HelloWord RGB saturation step"
	default 5
	range 1 100

config HW75_RGB_UNDERGLOW_BRT_STEP
	int "HelloWord RGB brightness step"
	default 5
	range 1 100

config HW75_RGB_UNDERGLOW_BRT_MIN
	int "HelloWord RGB minimum brightness"
	default 0
	range 0 100

config HW75_RGB_UNDERGLOW_BRT_MAX
	int "HelloWord RGB maximum brightness"
	default 100
	range 0 100

config HW75_RGB_UNDERGLOW_ON_START
	bool "HelloWord RGB on at startup"
	default y

config HW75_RGB_UNDERGLOW_AUTO_OFF_IDLE
	bool "HelloWord RGB auto off when idle"
	default n

config HW75_RGB_UNDERGLOW_AUTO_OFF_USB
	bool "HelloWord RGB auto off when USB is disconnected"
	default n

config HW75_RGB_UNDERGLOW_EXT_POWER
	bool "HelloWord RGB uses external power control"
	default n

endif # HW75_RGB_UNDERGLOW
```

## config/boards/arm/hw75_dynamic/app/uart_comm/Kconfig
```kconfig
# Copyright (c) 2022-2023 XiNGRZ
# SPDX-License-Identifier: MIT

DT_ALIAS_UART_COMM := uart-comm

config HW75_UART_COMM
	bool
	select SERIAL
	select HW75_PROTO_UART_COMM
	default $(dt_alias_enabled,$(DT_ALIAS_UART_COMM))

if HW75_UART_COMM

# Index of keymap layer used while keyboard holds FN (UART). Not hardcoded 1: layer 1 is "scroll".
config HW75_DYNAMIC_UART_FN_TARGET_LAYER
	int "Keymap layer index when keyboard FN is held"
	default 5
	range 0 31

config HW75_UART_COMM_THREAD_PRIORITY
	int
	default 10

config HW75_UART_COMM_THREAD_STACK_SIZE
	int
	default 1024

config HW75_UART_COMM_MAX_RX_MESSAGE_SIZE
	int
	default 64

module = HW75_UART_COMM
module-str = uart_comm
source "subsys/logging/Kconfig.template.log_config"

endif # HW75_UART_COMM
```

## config/boards/arm/hw75_keyboard/Kconfig.rgb
```kconfig
# Copyright (c) 2022-2023 XiNGRZ
# SPDX-License-Identifier: MIT

config ZMK_RGB_UNDERGLOW
	default n

config HW75_RGB_UNDERGLOW
	bool "HelloWord RGB underglow"
	default y
	select HW75_USB_COMM_FEATURE_RGB
	select WS2812_STRIP
	select LED_STRIP
	select SPI

config ZMK_RGB_UNDERGLOW_EFF_START
	int
	depends on HW75_RGB_UNDERGLOW
	default 0

config ZMK_RGB_UNDERGLOW_EXT_POWER
	bool
	depends on HW75_RGB_UNDERGLOW
	default n

config ZMK_RGB_UNDERGLOW_AUTO_OFF_IDLE
	bool
	depends on HW75_RGB_UNDERGLOW
	default n

config ZMK_RGB_UNDERGLOW_BRT_MAX
	int
	depends on HW75_RGB_UNDERGLOW
	default 100
```

## config/boards/arm/hw75_keyboard/app/Kconfig.touchbar
```kconfig
# Copyright (c) 2022-2023 XiNGRZ
# SPDX-License-Identifier: MIT

config HW75_TOUCHBAR
	bool "HelloWord TouchBar support"
	default y
	select HW75_HID_MOUSE
	select HW75_USB_COMM_FEATURE_TOUCHBAR
	depends on SETTINGS
```
