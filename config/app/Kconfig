## config/app/Kconfig
```kconfig
# Copyright (c) 2022-2023 XiNGRZ
# SPDX-License-Identifier: MIT

rsource "usb_comm/Kconfig"

config HW75_DIAG_LOG
	bool "Enable structured diagnostic logging"
	default y if HW75_USB_COMM
	depends on HW75_USB_COMM

if HW75_DIAG_LOG

config HW75_DIAG_LOG_RING_SIZE
	int "Diagnostic log event ring size"
	default 8

config HW75_DIAG_LOG_BOOT_EVENT_COUNT
	int "Diagnostic boot event count"
	default 4

endif # HW75_DIAG_LOG

config HW75_RGB_EFFECTS
	bool
	default y
	depends on ZMK_RGB_UNDERGLOW

config HW75_TOUCHBAR
	bool
	default y if BOARD_HW75_KEYBOARD
	depends on BOARD_HW75_KEYBOARD
	select HW75_HID_MOUSE

config HW75_FUNCTION_SLOT
	bool
	default y if BOARD_HW75_KEYBOARD
	depends on BOARD_HW75_KEYBOARD
	select SETTINGS if HW75_USB_COMM

rsource "Kconfig.hid_mouse"
rsource "Kconfig.indicator"
```

## config/boards/arm/hw75_dynamic/app/Kconfig.eink
```kconfig
# Copyright (c) 2023 XiNGRZ
# SPDX-License-Identifier: MIT

DT_ALIAS_EINK := eink

config HW75_EINK
	bool
	default $(dt_alias_enabled,$(DT_ALIAS_EINK))

config HW75_EINK_MODES
	bool "Multi-mode E-Ink engine (static / slideshow / clock+weather)"
	default y if HW75_EINK && BOARD_HW75_DYNAMIC
	depends on HW75_EINK
	select NVS
	select FLASH
	select FLASH_MAP
	help
	  Enable the E-Ink mode engine on hw75_dynamic. Provides a list
	  of user-configurable modes (static image, slideshow, clock+
	  weather, off) plus a behavior to cycle between them. Frame
	  bitmaps are stored in the eink_frames flash partition via NVS.
```

## config/boards/arm/hw75_dynamic/app/Kconfig.knob
```kconfig
# Copyright (c) 2023 XiNGRZ
# SPDX-License-Identifier: MIT

DT_ALIAS_KNOB := knob

config HW75_KNOB
	bool
	default $(dt_alias_enabled,$(DT_ALIAS_KNOB))

config HW75_KNOB_CALIBRATION_PERSIST
	bool "Persist manual knob zero offset calibration"
	default y if HW75_KNOB
	depends on HW75_KNOB && SETTINGS
	help
	  Store the user-adjusted motor zero offset and direction via
	  Zephyr settings (subtree "app/knob/calibration") and re-apply
	  them after the boot-time auto calibration.
```

## config/boards/arm/hw75_keyboard/Kconfig.usb
```kconfig
# Copyright (c) 2022-2023 XiNGRZ
# SPDX-License-Identifier: MIT

config HW75_USB_COMM
	bool
	default y
	select HW75_USB_COMM_FEATURE_RGB
	select HW75_USB_COMM_FEATURE_DEBUG_LOG

if HW75_USB_COMM

config HW75_USB_COMM_THREAD_STACK_SIZE
	int
	default 1024

config HW75_USB_COMM_MAX_TX_MESSAGE_SIZE
	int
	default 256

config HW75_USB_COMM_MAX_RX_MESSAGE_SIZE
	int
	default 64

endif # HW75_USB_COMM
```

## config/boards/arm/hw75_keyboard/app/uart_comm/Kconfig
```kconfig
# Copyright (c) 2022-2023 XiNGRZ
# SPDX-License-Identifier: MIT

DT_ALIAS_UART_COMM := uart-comm

config HW75_UART_COMM
	bool "Send keyboard -> dynamic ping / FN state reports over UART SLIP"
	select SERIAL
	select HW75_PROTO_UART_COMM
	default $(dt_alias_enabled,$(DT_ALIAS_UART_COMM))
	help
	  Enables periodic keepalive + FN-state reports from keyboard to
	  dynamic via UART SLIP. uart_slip_send() has a 20ms total deadline
	  (non-blocking uart_fifo_fill + k_yield loop) so a stalled TX line
	  cannot hang the caller even if the dynamic is stuck in its UF2
	  bootloader.

if HW75_UART_COMM

config HW75_UART_COMM_MAX_TX_MESSAGE_SIZE
	int
	default 64

module = HW75_UART_COMM
module-str = uart_comm
source "subsys/logging/Kconfig.template.log_config"

endif # HW75_UART_COMM
```

## config/dts/bindings/behaviors/zmk,behavior-eink-mode-cycle.yaml
```yaml
# Copyright (c) 2026
# SPDX-License-Identifier: MIT

description: Cycle the active E-Ink mode by a signed delta (+1/-1)

compatible: "zmk,behavior-eink-mode-cycle"

include: one_param.yaml
```

## config/dts/bindings/behaviors/zmk,behavior-function-slot.yaml
```yaml
description: Runtime function slot behavior
compatible: "zmk,behavior-function-slot"

include: one_param.yaml
```

## config/dts/bindings/behaviors/zmk,behavior-rgb-send.yaml
```yaml
# Copyright (c) 2026
# SPDX-License-Identifier: MIT

description: Send a D2K_RGB opcode to the keyboard underglow over the reverse UART

compatible: "zmk,behavior-rgb-send"

include: one_param.yaml
```

## config/dts/bindings/behaviors/zmk,behavior-tb-send.yaml
```yaml
# Copyright (c) 2026
# SPDX-License-Identifier: MIT

description: Cycle the keyboard TouchBar mode from the dynamic over the reverse UART

compatible: "zmk,behavior-tb-send"

include: one_param.yaml
```

## config/dts/bindings/behaviors/zmk,behavior-touchbar-mode.yaml
```yaml
# Copyright (c) 2026
# SPDX-License-Identifier: MIT

description: TouchBar mode cycle behavior

compatible: "zmk,behavior-touchbar-mode"

include: zero_param.yaml
```
