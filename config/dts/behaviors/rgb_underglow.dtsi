/*
 * Copyright (c) 2022-2023 XiNGRZ
 * SPDX-License-Identifier: MIT
 */

/ {
	behaviors {
		/omit-if-no-ref/ rgb_ug: rgb_underglow {
			compatible = "zmk,behavior-rgb-underglow";
			label = "RGB_UNDERGLOW";
			#binding-cells = <2>;
		};
	};
};
