/*
 * Copyright (c) 2026
 * SPDX-License-Identifier: MIT
 */

/ {
	behaviors {
		/omit-if-no-ref/ rgb_send: behavior_rgb_send {
			compatible = "zmk,behavior-rgb-send";
			label = "RGB_SEND";
			#binding-cells = <1>;
		};
	};
};
